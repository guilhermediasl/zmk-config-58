## boards/shields/Scylla/Kconfig.shield
```kconfig
config SHIELD_DACTYL_MANUFORM_LEFT
    def_bool $(shields_list_contains,scylla_left)

config SHIELD_DACTYL_MANUFORM_RIGHT
    def_bool $(shields_list_contains,scylla_right)
```
